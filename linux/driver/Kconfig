## linux/driver/Kconfig
```kconfig
menu "Loongson mySOC board drivers"

source "drivers/mysoc/confreg/Kconfig"
source "drivers/mysoc/vga/Kconfig"

endmenu
```

## linux/driver/confreg/Kconfig
```kconfig
config LOONGSON_CONFREG
	tristate "Loongson mySOC CONFREG support"
	depends on OF && HAS_IOMEM
	help
	  Expose the confreg register bank implemented by confreg_syn.v through
	  /dev/confreg.  The device supports aligned pread/pwrite and ioctl access;
	  writes require CAP_SYS_RAWIO.
```

## linux/driver/usb/Kconfig
```kconfig
config USB_UE11_HCD
	tristate "UE11 USB 1.1 host controller"
	depends on USB && OF && HAS_IOMEM
	help
	  Enable support for the UE11 USB 1.1 host controller used by the
	  Loongson mySOC FPGA platform.
```

## linux/driver/vga/Kconfig
```kconfig
config FB_LOONGSON_MYSOC_VGA
	tristate "Loongson mySOC AXI VDMA/VTC VGA framebuffer"
	depends on FB && OF && HAS_IOMEM && HAS_DMA && COMMON_CLK
	select VIDEOMODE_HELPERS
	select FB_CFB_FILLRECT
	select FB_CFB_COPYAREA
	select FB_CFB_IMAGEBLIT
	select FB_SYS_FOPS
	help
	  Framebuffer driver for the project-specific pipeline made from
	  axi_vdma_0, v_tc_0 and v_axi4s_vid_out_0.  It creates /dev/fb0 and
	  drives the board's direct RGB444 resistor DAC.
```
